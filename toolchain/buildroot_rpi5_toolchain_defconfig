## toolchain/buildroot_rpi5_toolchain_defconfig
```kconfig
BR2_aarch64=y
BR2_cortex_a76=y
BR2_BINUTILS_VERSION_2_44_X=y
BR2_TOOLCHAIN_BUILDROOT_CXX=y
BR2_GCC_ENABLE_OPENMP=y
BR2_CCACHE=y
# BR2_TARGET_ENABLE_ROOT_LOGIN is not set
# BR2_TARGET_ROOTFS_TAR is not set
```
